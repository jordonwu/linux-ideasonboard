## Documentation/devicetree/bindings/media/i2c/imx296.yaml
```yaml
# SPDX-License-Identifier: (GPL-2.0 OR BSD-2-Clause)
%YAML 1.2
---
$id: http://devicetree.org/schemas/media/i2c/imx296.yaml#
$schema: http://devicetree.org/meta-schemas/core.yaml#

title: Sony IMX296 1/2.8-Inch CMOS Image Sensor

maintainers:
  - Manivannan Sadhasivam <manivannan.sadhasivam@linaro.org>

description: |-
  The Sony IMX296 is a 1/2.9-Inch active pixel type CMOS Solid-state image
  sensor with square pixel array and 1.58 M effective pixels. This chip
  features a global shutter with variable charge-integration time. It is
  programmable through I2C and 4-wire interfaces. The sensor output is
  available via CSI-2 serial data output (1 Lane).

properties:
  compatible:
    enum:
      - sony,imx296
      - sony,imx296ll
      - sony,imx296lq
    description:
      The IMX296 sensor exists in two different models, a colour variant
      (IMX296LQ) and a monochrome variant (IMX296LL). The device exposes the
      model through registers, allowing for auto-detection with a common
      "sony,imx296" compatible string. However, some camera modules disable the
      ability to read the sensor model register, which disables this feature.
      In those cases, the exact model needs to be specified as "sony,imx296ll"
      or "sony,imx296lq".

  reg:
    maxItems: 1

  clocks:
    maxItems: 1

  clock-names:
    description:
      Input clock for the sensor.
    items:
      - const: mclk

  clock-frequency:
    description:
      Frequency of the mclk clock in Hertz.

  vddo-supply:
    description:
      Definition of the regulator used as interface power supply.

  vdda-supply:
    description:
      Definition of the regulator used as analog power supply.

  vddd-supply:
    description:
      Definition of the regulator used as digital power supply.

  reset-gpios:
    description:
      The phandle and specifier for the GPIO that controls sensor reset.
    maxItems: 1

  port: true

required:
  - compatible
  - reg
  - clocks
  - clock-names
  - clock-frequency
  - vddo-supply
  - vdda-supply
  - vddd-supply

additionalProperties: false

examples:
  - |
    #include <dt-bindings/gpio/gpio.h>

    imx296: camera-sensor@1a {
        compatible = "sony,imx296";
        reg = <0x1a>;
        reset-gpios = <&msmgpio 35 GPIO_ACTIVE_LOW>;
        pinctrl-names = "default";
        pinctrl-0 = <&camera_rear_default>;
        clocks = <&gcc 90>;
        clock-names = "mclk";
        clock-frequency = <37125000>;
        vddo-supply = <&camera_vddo_1v8>;
        vdda-supply = <&camera_vdda_3v3>;
        vddd-supply = <&camera_vddd_1v2>;

        port {
            imx296_ep: endpoint {
                remote-endpoint = <&csiphy0_ep>;
            };
        };
    };

...
```

## drivers/media/platform/nxp/Kconfig
```kconfig
# SPDX-License-Identifier: GPL-2.0-only

# V4L drivers

comment "NXP media platform drivers"

source "drivers/media/platform/nxp/imx8-isi/Kconfig"

# mem2mem drivers

source "drivers/media/platform/nxp/imx-jpeg/Kconfig"
```
